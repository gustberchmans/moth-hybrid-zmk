## boards/seeed/xiao_ble_plus/Kconfig.xiao_ble_plus
```kconfig
config BOARD_XIAO_BLE_PLUS
    select SOC_NRF52840_QIAA
    select BOARD_HAS_NRF5_BOOTLOADER
    select ZMK_BOARD_COMPAT if ZMK
```

## boards/seeed/xiao_ble_plus/board.yml
```yaml
board:
  name: xiao_ble_plus
  vendor: seeed
  socs:
    - name: nrf52840
      variants:
        - name: zmk
```

## boards/seeed/xiao_ble_plus/xiao_ble_plus_nrf52840_defconfig
```kconfig
# Enable GPIO
CONFIG_GPIO=y

# Enable clock control
CONFIG_CLOCK_CONTROL=y

# Code partition needed for correct flash range
CONFIG_USE_DT_CODE_PARTITION=y

# Output UF2 with correct family ID for nRF52840
CONFIG_BUILD_OUTPUT_UF2=y
CONFIG_BUILD_OUTPUT_UF2_FAMILY_ID="0xADA52840"

# USB HID
CONFIG_ZMK_USB=y

# BLE HID
CONFIG_ZMK_BLE=y

# Settings Support
CONFIG_MPU_ALLOW_FLASH_WRITE=y
CONFIG_NVS=y
CONFIG_SETTINGS_NVS=y
CONFIG_FLASH=y
CONFIG_FLASH_PAGE_LAYOUT=y
CONFIG_FLASH_MAP=y

# Enable MPU
CONFIG_ARM_MPU=y

# Enable HW stack protection
CONFIG_HW_STACK_PROTECTION=y

# Pin control
CONFIG_PINCTRL=y

# USB device info
CONFIG_USB_DEVICE_STACK=y
CONFIG_USB_DEVICE_MANUFACTURER="Seeed"
CONFIG_USB_DEVICE_PRODUCT="XIAO nRF52840 Plus"
CONFIG_USB_DEVICE_VID=0x2886
CONFIG_USB_DEVICE_PID=0x0052

CONFIG_FLASH_PAGE_LAYOUT=y
CONFIG_FLASH_MAP=y
```

## config/boards/arm/xiao_ble_plus/Kconfig.board
```kconfig
config BOARD_XIAO_BLE_PLUS
    bool "Seeed XIAO nRF52840 Plus Custom"
    depends on SOC_NRF52840_QIAA
```

## config/boards/arm/xiao_ble_plus/xiao_ble_plus_defconfig
```kconfig
CONFIG_BOARD_XIAO_BLE_PLUS=y
CONFIG_SOC_SERIES_NRF52X=y
CONFIG_SOC_NRF52840_QIAA=y
CONFIG_BOARD_ENABLE_DCDC=y

# Reuse standard console and USB settings from the stock Xiao BLE
CONFIG_CONSOLE=y
CONFIG_UART_CONSOLE=y
CONFIG_SERIAL=y
CONFIG_UART_NRFX=y
CONFIG_GPIO=y
```

## config/boards/shields/moth_hybrid/Kconfig.defconfig
```kconfig
if SHIELD_MOTH_HYBRID_LEFT

config ZMK_KEYBOARD_NAME
    default "Moth Hybrid"

config ZMK_SPLIT_ROLE_CENTRAL
    default y

endif

if SHIELD_MOTH_HYBRID_LEFT || SHIELD_MOTH_HYBRID_RIGHT

config ZMK_SPLIT
    default y

endif
```

## config/boards/shields/moth_hybrid/Kconfig.shield
```kconfig
config SHIELD_MOTH_HYBRID_LEFT
    def_bool $(shields_list_contains,moth_hybrid_left)

config SHIELD_MOTH_HYBRID_RIGHT
    def_bool $(shields_list_contains,moth_hybrid_right)
```

## config/west.yml
```yaml
manifest:
  remotes:
    - name: zmkfirmware
      url-base: https://github.com/zmkfirmware
    - name: gustberchmans
      url-base: https://github.com/gustberchmans
  projects:
    - name: zmk
      remote: zmkfirmware
      revision: main
      import: app/west.yml
    - name: moth-hybrid-zmk
      remote: gustberchmans
      revision: main
  self:
    path: config
```
